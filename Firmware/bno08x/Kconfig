## Firmware/bno08x/drivers/sensor/bno08x/Kconfig
```kconfig
# BNO08X IMU configuration

# Copyright (c) 2024 Diodes Delight
# SPDX-License-Identifier: Apache-2.0

menuconfig BNO08X
	bool "BNO08X Inertial measurement unit"
	default y
	depends on DT_HAS_CEVA_BNO08X_ENABLED
	select I2C if $(dt_compat_on_bus,$(DT_COMPAT_CEVA_BNO08X),i2c)
	select SPI if $(dt_compat_on_bus,$(DT_COMPAT_CEVA_BNO08X),spi)
	help
	  Enable driver for BNO08X sensor fusion IMU

if BNO08X

config BNO08X_BUS_I2C
	bool
	default y
	depends on $(dt_compat_on_bus,$(DT_COMPAT_CEVA_BNO08X),i2c)

config BNO08X_BUS_SPI
	bool
	default y
	depends on $(dt_compat_on_bus,$(DT_COMPAT_CEVA_BNO08X),spi)

endif # BNO08X
```

## Firmware/bno08x/dts/bindings/sensor/ceva,bno08x-spi.yaml
```yaml
# Copyright (c) 2024, Diodes Delight
# SPDX-License-Identifier: Apache-2.0

description: |
    BNO085 and BNO086 are 9-axis Absolute Orientation Sensors
    doing on device sensor fusion from CEVA.

compatible: "ceva,bno08x"

include: ["spi-device.yaml", "ceva,bno08x.yaml"]
```

## Firmware/bno08x/dts/bindings/sensor/ceva,bno08x.yaml
```yaml
# Copyright (c) 2024, Diodes Delight
# SPDX-License-Identifier: Apache-2.0

description: |
    BNO085 and BNO086 are 9-axis Absolute Orientation Sensors
    doing on device sensor fusion from CEVA.

include: sensor-device.yaml

compatible: "ceva,bno08x"

properties:
  irq-gpios:
    type: phandle-array
    description: |
      Interrupt pin for the sensor. Mostly for SPI use.
  wake-gpios:
    type: phandle-array
    description: |
      PS2/Wake pin for SPI use
  reset-gpios:
    type: phandle-array
    description: |
      Reset pin
```
